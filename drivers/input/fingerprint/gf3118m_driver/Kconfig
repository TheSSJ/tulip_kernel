## drivers/input/fingerprint/gf3118m_driver/Kconfig
```kconfig
config FINGERPRINT_GOODIX_GF3118M
	tristate "goodix fingerprint fp driver"
	default n
```

## drivers/input/touchscreen/synaptics_dsx_v26/Kconfig
```kconfig
#
# Synaptics DSX touchscreen driver configuration
#
menuconfig TOUCHSCREEN_SYNAPTICS_DSX_v26
	bool "Synaptics DSX touchscreen"
	help
	  Say Y here if you have a Synaptics DSX touchscreen connected
	  to your system.

	  If unsure, say N.

if TOUCHSCREEN_SYNAPTICS_DSX_v26

choice
	default TOUCHSCREEN_SYNAPTICS_DSX_I2C_v26
	prompt "Synaptics DSX touchscreen bus interface"

config TOUCHSCREEN_SYNAPTICS_DSX_I2C_v26
	bool "I2C"
	depends on I2C
	help
	  Say Y here if you have a Synaptics DSX touchscreen interfaced
	  to the host processor over I2C

	  If unsure, say N.

	  This module uses the services of DSX CORE

config TOUCHSCREEN_SYNAPTICS_DSX_SPI_v26
	bool "SPI"
	depends on SPI_MASTER
	help
	  Say Y here if you have a Synaptics DSX touchscreen interfaced
	  to the host processor over SPI

	  If unsure, say N.

	  This module uses the services of DSX CORE
endchoice

config TOUCHSCREEN_SYNAPTICS_DSX_CORE_v26
	tristate "Synaptics DSX core driver module"
	depends on TOUCHSCREEN_SYNAPTICS_DSX_I2C_v26 || TOUCHSCREEN_SYNAPTICS_DSX_SPI_v26
	help
	  Say Y here to enable basic touch reporting functionalities.

	  If unsure, say N.

	  To compile this driver as a module, choose M here: the
	  module will be called synaptics_dsx_core.

config TOUCHSCREEN_SYNAPTICS_DSX_RMI_DEV_v26
	tristate "Synaptics DSX touchscreen RMI device module"
	depends on TOUCHSCREEN_SYNAPTICS_DSX_CORE_v26
	help
	  Say Y here to enable support for direct RMI register access.

	  If unsure, say N.

	  To compile this driver as a module, choose M here: the
	  module will be called synaptics_dsx_rmi_dev.

config TOUCHSCREEN_SYNAPTICS_DSX_FW_UPDATE_v26
	tristate "Synaptics DSX touchscreen firmware update module"
	depends on TOUCHSCREEN_SYNAPTICS_DSX_CORE_v26
	help
	  Say Y here to enable support for carrying out firmware update.

	  If unsure, say N.

	  To compile this driver as a module, choose M here: the
	  module will be called synaptics_dsx_fw_update.

config TOUCHSCREEN_SYNAPTICS_DSX_PROXIMITY_v26
	tristate "Synaptics DSX touchscreen proximity module"
	depends on TOUCHSCREEN_SYNAPTICS_DSX_CORE_v26
	help
	  Say Y here to enable support for proximity functionalities.

	  If unsure, say N.

	  To compile this driver as a module, choose M here: the
	  module will be called synaptics_dsx_proximity.

config TOUCHSCREEN_SYNAPTICS_DSX_TEST_v26
	tristate "Synaptics DSX touchscreen test module"
	depends on TOUCHSCREEN_SYNAPTICS_DSX_CORE_v26
	help
	  Say Y here to enable support for debug functionalities.

	  If unsure, say N.

	  To compile this driver as a module, choose M here: the
	  module will be called synaptics_dsx_test_reporting.

config TOUCHSCREEN_SYNAPTICS_DSX_GESTURE_v26
	tristate "Synaptics DSX user defined gesture module"
	depends on TOUCHSCREEN_SYNAPTICS_DSX_CORE_v26
	help
	  Say Y here to enable support for user defined gesture functionality.

	  If unsure, say N.

	  To compile this driver as a module, choose M here: the
	  module will be called synaptics_dsx_gesture.

config TOUCHSCREEN_SYNAPTICS_DSX_DEBUG_v26
	tristate "Synaptics DSX user defined gesture module"
	depends on TOUCHSCREEN_SYNAPTICS_DSX_CORE_v26
	help
	  Say Y here to enable support for user defined gesture functionality.

	  If unsure, say N.

	  To compile this driver as a module, choose M here: the
	  module will be called synaptics_dsx_gesture.


endif
```

## drivers/input/touchscreen/synaptics_zte_1.0/Kconfig
```kconfig
#
# Synaptics DSX touchscreen driver configuration
#
menuconfig TOUCHSCREEN_SYNAPTICS_ZTE_V10
	bool "Synaptics DSX touchscreen"
	help
	  Say Y here, and a list of supported touchscreens will be displayed.
	  This option doesn't affect the kernel.

	  If unsure, say Y.

config TOUCHSCREEN_SYNAPTICS_DSX_I2C_V10
	bool "Synaptics DSX I2C touchscreen"
	depends on I2C
	help
	  Say Y here if you have a Synaptics DSX I2C touchscreen
	  connected to your system.

	  If unsure, say N.

	  To compile this driver as a module, choose M here: the
	  module will be called synaptics_i2c_rmi4.

config TOUCHSCREEN_SYNAPTICS_DSX_RMI_DEV_V10
	bool "Synaptics I2C touchscreen rmi device"
	depends on TOUCHSCREEN_SYNAPTICS_DSX_I2C_V10
	help
	  This enables support for character device channel for Synaptics
	  RMI4 touchscreens.

	  Say Y here if you have a Synaptics DSX I2C touchscreen
	  connected to your system.

	  If unsure, say N.

	  To compile this driver as a module, choose M here: the
	  module will be called synaptics_dsx_rmi4_dev.

config TOUCHSCREEN_SYNAPTICS_DSX_FW_UPDATE_V10
	bool "Synaptics I2C touchscreen firmware update"
	depends on TOUCHSCREEN_SYNAPTICS_DSX_I2C_V10
	help
	  This enables support for firmware update for Synaptics RMI4
	  touchscreens.

	  Say Y here if you have a Synaptics DSX I2C touchscreen
	  connected to your system.

	  If unsure, say N.

	  To compile this driver as a module, choose M here: the
	  module will be called synaptics_dsx_fw_update.

config TOUCHSCREEN_SYNAPTICS_DSX_TEST_REPORTING_V10
	bool "Synaptics I2C touchscreen TEST REPORTING"
	depends on TOUCHSCREEN_SYNAPTICS_DSX_I2C_V10
	help
	  This enables support for TEST REPORTING for Synaptics RMI4
	  touchscreens.

	  Say Y here if you have a Synaptics DSX I2C touchscreen
	  connected to your system.

	  If unsure, say N.

	  To compile this driver as a module, choose M here: the
	  module will be called synaptics_dsx_fw_update.
```

## drivers/input/ztemisc/Kconfig
```kconfig
#
# Input misc drivers configuration
#
menuconfig ZTE_INPUT_MISC
	bool "ZTE Miscellaneous devices"
	help
	  Say Y here, and a list of miscellaneous input drivers will be displayed.
	  Everything that didn't fit into the other categories is here. This option
	  doesn't affect the kernel.

	  If unsure, say Y.

if ZTE_INPUT_MISC

config INPUT_SX9500
	tristate "SX9500 based capacitive touch button"
	depends on I2C
	help
	  Say Y here if you have a SX9500.

	  If unsure, say N.

	  To compile this driver as a module, choose M here: the
	  module will be called SX9500.

config INPUT_SX9310
	tristate "SX9310 based capacitive touch button"
	depends on I2C
	help
	  Say Y here if you have a SX9310.

	  If unsure, say N.

	  To compile this driver as a module, choose M here: the
	  module will be called SX9310.

endif
```
