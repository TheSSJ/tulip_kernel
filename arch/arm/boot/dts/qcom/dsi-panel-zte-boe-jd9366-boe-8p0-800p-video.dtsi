/* Copyright (c) 2015, The Linux Foundation. All rights reserved.
 *
 * This program is free software; you can redistribute it and/or modify
 * it under the terms of the GNU General Public License version 2 and
 * only version 2 as published by the Free Software Foundation.
 *
 * This program is distributed in the hope that it will be useful,
 * but WITHOUT ANY WARRANTY; without even the implied warranty of
 * MERCHANTABILITY or FITNESS FOR A PARTICULAR PURPOSE.  See the
 * GNU General Public License for more details.
 */

&mdss_mdp {
	dsi_boe_jd9366_boe_8p0_800P_video_vid: qcom,mdss_dsi_boe_jd9366_boe_8p0_800p_video {
		qcom,mdss-dsi-panel-name = "zteBOE(JD9366)BOE_800*1280_8P0Inch";
		qcom,mdss-dsi-panel-type = "dsi_video_mode";
		qcom,cont-splash-enabled;
		qcom,mdss-pan-physical-width-dimension = <108>;
		qcom,mdss-pan-physical-height-dimension = <173>;
		qcom,mdss-dsi-panel-framerate = <60>;
		qcom,mdss-dsi-virtual-channel-id = <0>;
		qcom,mdss-dsi-stream = <0>;
		qcom,mdss-dsi-panel-width = <800>;
		qcom,mdss-dsi-panel-height = <1280>;
		//qcom,mdss-dsi-h-front-porch = <32>;
		qcom,mdss-dsi-h-front-porch = <40>; //mipi clk=411.21, confirmed with vendor, for P895A80 on 20160517, caojian.
		qcom,mdss-dsi-h-back-porch = <20>;
		qcom,mdss-dsi-h-pulse-width = <20>;
		qcom,mdss-dsi-h-sync-skew = <0>;
		qcom,mdss-dsi-v-back-porch = <6>;
		qcom,mdss-dsi-v-front-porch = <8>;
		qcom,mdss-dsi-v-pulse-width = <4>;
		qcom,mdss-dsi-h-left-border = <0>;
		qcom,mdss-dsi-h-right-border = <0>;
		qcom,mdss-dsi-v-top-border = <0>;
		qcom,mdss-dsi-v-bottom-border = <0>;
		qcom,mdss-dsi-bpp = <24>;
		qcom,mdss-dsi-underflow-color = <0xff>;
		qcom,mdss-dsi-border-color = <0>;
		qcom,mdss-dsi-h-sync-pulse = <0>;
		qcom,mdss-dsi-traffic-mode = "burst_mode";

		qcom,mdss-dsi-te-pin-select = <1>;
		qcom,mdss-dsi-te-dcs-command = <1>;
		qcom,mdss-dsi-te-check-enable;
		qcom,mdss-dsi-te-using-te-pin;
		qcom,mdss-dsi-wr-mem-start = <0x2c>;
		qcom,mdss-dsi-wr-mem-continue = <0x3c>;

		qcom,mdss-dsi-bllp-eof-power-mode;
		qcom,mdss-dsi-bllp-power-mode;
		qcom,mdss-dsi-lane-0-state;
		qcom,mdss-dsi-lane-1-state;
		qcom,mdss-dsi-lane-2-state;
		qcom,mdss-dsi-lane-3-state;
		qcom,mdss-dsi-panel-timings = [7B 1A 10 00 3E 42 14 1C 15 03 04 00];
		qcom,mdss-dsi-t-clk-post = <0x04>;
		qcom,mdss-dsi-t-clk-pre = <0x1A>;
		qcom,mdss-dsi-bl-min-level = <1>;
		qcom,mdss-dsi-bl-max-level = <255>;
		qcom,mdss-dsi-dma-trigger = "trigger_sw";
		qcom,mdss-dsi-mdp-trigger = "none";
		qcom,mdss-dsi-on-command = [

			   39 01 00 00 00 00 02 E0 00
			   39 01 00 00 00 00 02 E1 93
			   39 01 00 00 00 00 02 E2 65
			   39 01 00 00 00 00 02 E3 F8
			   39 01 00 00 00 00 02 80 03


			   39 01 00 00 00 00 02 E0 01

			   39 01 00 00 00 00 02 00 00
			   39 01 00 00 00 00 02 01 AE
			   39 01 00 00 00 00 02 03 00
			   39 01 00 00 00 00 02 04 AE


			   39 01 00 00 00 00 02 17 00
			   39 01 00 00 00 00 02 18 B1
			   39 01 00 00 00 00 02 19 01
			   39 01 00 00 00 00 02 1A 00
			   39 01 00 00 00 00 02 1B B1
			   39 01 00 00 00 00 02 1C 01


			   39 01 00 00 00 00 02 1F 3E
			   39 01 00 00 00 00 02 20 28
			   39 01 00 00 00 00 02 21 28
			   39 01 00 00 00 00 02 22 0E


             		   39 01 00 00 00 00 02 37 19

			   39 01 00 00 00 00 02 38 05
			   39 01 00 00 00 00 02 39 08
			   39 01 00 00 00 00 02 3A 12
			   39 01 00 00 00 00 02 3C 78
			   39 01 00 00 00 00 02 3D FF
			   39 01 00 00 00 00 02 3E FF
              		   39 01 00 00 00 00 02 3F FF

                         39 01 00 00 00 00 02 40 06
			   39 01 00 00 00 00 02 41 A0
			   39 01 00 00 00 00 02 4B 04

			   39 01 00 00 00 00 02 55 00
			   39 01 00 00 00 00 02 56 01
			   39 01 00 00 00 00 02 57 89
               	   39 01 00 00 00 00 02 58 0A
			   39 01 00 00 00 00 02 59 0A
			   39 01 00 00 00 00 02 5A 28
			   39 01 00 00 00 00 02 5B 14

			   39 01 00 00 00 00 02 5D 7C
			   39 01 00 00 00 00 02 5E 61
               	   39 01 00 00 00 00 02 5F 50
                         39 01 00 00 00 00 02 60 44
			   39 01 00 00 00 00 02 61 41
			   39 01 00 00 00 00 02 62 30
			   39 01 00 00 00 00 02 63 36
			   39 01 00 00 00 00 02 64 1E
			   39 01 00 00 00 00 02 65 37
			   39 01 00 00 00 00 02 66 36
                         39 01 00 00 00 00 02 67 36
                         39 01 00 00 00 00 02 68 56
			   39 01 00 00 00 00 02 69 42
			   39 01 00 00 00 00 02 6A 48
			   39 01 00 00 00 00 02 6B 39
			   39 01 00 00 00 00 02 6C 2F
			   39 01 00 00 00 00 02 6D 21
			   39 01 00 00 00 00 02 6E 10
                         39 01 00 00 00 00 02 6F 00
                         39 01 00 00 00 00 02 70 7C
			   39 01 00 00 00 00 02 71 61
			   39 01 00 00 00 00 02 72 50
			   39 01 00 00 00 00 02 73 44
			   39 01 00 00 00 00 02 74 41
			   39 01 00 00 00 00 02 75 30
			   39 01 00 00 00 00 02 76 36
                         39 01 00 00 00 00 02 77 1E
                         39 01 00 00 00 00 02 78 38
                         39 01 00 00 00 00 02 79 36
			   39 01 00 00 00 00 02 7A 36
			   39 01 00 00 00 00 02 7B 54
			   39 01 00 00 00 00 02 7C 42
			   39 01 00 00 00 00 02 7D 48
			   39 01 00 00 00 00 02 7E 39
			   39 01 00 00 00 00 02 7F 2F
                         39 01 00 00 00 00 02 80 21
			   39 01 00 00 00 00 02 81 10
			   39 01 00 00 00 00 02 82 00

			   39 01 00 00 00 00 02 E0 02

			   39 01 00 00 00 00 02 00 47
                         39 01 00 00 00 00 02 01 47
                         39 01 00 00 00 00 02 02 45
			   39 01 00 00 00 00 02 03 45
			   39 01 00 00 00 00 02 04 4B
			   39 01 00 00 00 00 02 05 4B
			   39 01 00 00 00 00 02 06 49
			   39 01 00 00 00 00 02 07 49
			   39 01 00 00 00 00 02 08 41
                         39 01 00 00 00 00 02 09 1F
                         39 01 00 00 00 00 02 0A 1F
			   39 01 00 00 00 00 02 0B 1F
			   39 01 00 00 00 00 02 0C 1F
			   39 01 00 00 00 00 02 0D 1F
			   39 01 00 00 00 00 02 0E 1F
			   39 01 00 00 00 00 02 0F 43
			   39 01 00 00 00 00 02 10 1F
                         39 01 00 00 00 00 02 11 1F
                         39 01 00 00 00 00 02 12 1F
			   39 01 00 00 00 00 02 13 1F
			   39 01 00 00 00 00 02 14 1F
			   39 01 00 00 00 00 02 15 1F

			   39 01 00 00 00 00 02 16 46
			   39 01 00 00 00 00 02 17 46
                         39 01 00 00 00 00 02 18 44
                         39 01 00 00 00 00 02 19 44
                         39 01 00 00 00 00 02 1A 4A
			   39 01 00 00 00 00 02 1B 4A
			   39 01 00 00 00 00 02 1C 48
			   39 01 00 00 00 00 02 1D 48
			   39 01 00 00 00 00 02 1E 40
			   39 01 00 00 00 00 02 1F 1F
			   39 01 00 00 00 00 02 20 1F
                         39 01 00 00 00 00 02 21 1F
			   39 01 00 00 00 00 02 22 1F
			   39 01 00 00 00 00 02 23 1F
			   39 01 00 00 00 00 02 24 1F
			   39 01 00 00 00 00 02 25 42
			   39 01 00 00 00 00 02 26 1F
			   39 01 00 00 00 00 02 27 1F
                         39 01 00 00 00 00 02 28 1F
                         39 01 00 00 00 00 02 29 1F
			   39 01 00 00 00 00 02 2A 1F
			   39 01 00 00 00 00 02 2B 1F

			   39 01 00 00 00 00 02 2C 11
			   39 01 00 00 00 00 02 2D 0F
			   39 01 00 00 00 00 02 2E 0D
                         39 01 00 00 00 00 02 2F 0B
                         39 01 00 00 00 00 02 30 09
			   39 01 00 00 00 00 02 31 07
			   39 01 00 00 00 00 02 32 05
			   39 01 00 00 00 00 02 33 18
			   39 01 00 00 00 00 02 34 17
			   39 01 00 00 00 00 02 35 1F
			   39 01 00 00 00 00 02 36 01
                         39 01 00 00 00 00 02 37 1F
                         39 01 00 00 00 00 02 38 1F
			   39 01 00 00 00 00 02 39 1F
			   39 01 00 00 00 00 02 3A 1F
			   39 01 00 00 00 00 02 3B 1F
			   39 01 00 00 00 00 02 3C 1F
			   39 01 00 00 00 00 02 3D 1F
			   39 01 00 00 00 00 02 3E 1F
                         39 01 00 00 00 00 02 3F 13
                         39 01 00 00 00 00 02 40 1F
                         39 01 00 00 00 00 02 41 1F

			   39 01 00 00 00 00 02 42 10
			   39 01 00 00 00 00 02 43 0E
			   39 01 00 00 00 00 02 44 0C
			   39 01 00 00 00 00 02 45 0A
			   39 01 00 00 00 00 02 46 08
                         39 01 00 00 00 00 02 47 06
			   39 01 00 00 00 00 02 48 04
			   39 01 00 00 00 00 02 49 18
			   39 01 00 00 00 00 02 4A 17
			   39 01 00 00 00 00 02 4B 1F
			   39 01 00 00 00 00 02 4C 00
			   39 01 00 00 00 00 02 4D 1F
                         39 01 00 00 00 00 02 4E 1F
                         39 01 00 00 00 00 02 4F 1F
			   39 01 00 00 00 00 02 50 1F
			   39 01 00 00 00 00 02 51 1F
			   39 01 00 00 00 00 02 52 1F
			   39 01 00 00 00 00 02 53 1F
			   39 01 00 00 00 00 02 54 1F
			   39 01 00 00 00 00 02 55 12
                         39 01 00 00 00 00 02 56 1F
                         39 01 00 00 00 00 02 57 1F

			   39 01 00 00 00 00 02 58 40
			   39 01 00 00 00 00 02 5B 30
			   39 01 00 00 00 00 02 5C 04
			   39 01 00 00 00 00 02 5D 40
			   39 01 00 00 00 00 02 5E 01
                         39 01 00 00 00 00 02 5F 02
                         39 01 00 00 00 00 02 63 62
			   39 01 00 00 00 00 02 64 62

			   39 01 00 00 00 00 02 67 74
			   39 01 00 00 00 00 02 68 06
			   39 01 00 00 00 00 02 69 62
			   39 01 00 00 00 00 02 6A 66
                         39 01 00 00 00 00 02 6B 08
                         39 01 00 00 00 00 02 6C 00
                         39 01 00 00 00 00 02 6D 00
			   39 01 00 00 00 00 02 6E 00
			   39 01 00 00 00 00 02 6F 08

			   39 01 00 00 00 00 02 E0 03
			   39 01 00 00 00 00 02 98 3E

                         39 01 00 00 00 00 02 E0 04
			   39 01 00 00 00 00 02 09 14
			   39 01 00 00 00 00 02 2B 2B
			   39 01 00 00 00 00 02 2E 44

			   39 01 00 00 00 00 02 E0 00

                         39 01 00 00 00 00 02 E6 02
                         39 01 00 00 00 00 02 E7 06

			   39 01 00 00 00 00 02 E0 03
			   39 01 00 00 00 00 02 9B 04       // N_VAL set PWM Frequency 31KHz

			   39 01 00 00 00 00 02 E0 00

			   39 01 00 00 00 00 02 35 00

			   39 01 00 00 00 00 02 51 FF
			   //39 01 00 00 00 00 02 53 24
			   39 01 00 00 00 00 02 53 2c  //zte_tzb move 53h to initial code, 20160505

                         05 01 00 00 c8 00 02 11 00
                         05 01 00 00 0a 00 02 29 00
			];
		qcom,mdss-dsi-off-command = [
				 //39 01 00 00 96 00 02 51 00
				 39 01 00 00 78 00 02 53 00 //zte_tzb add to close backlight quickly when sleep in, 20160505
				 05 01 00 00 96 00 02 28 00
				 05 01 00 00 96 00 02 10 00];
		qcom,mdss-dsi-on-command-state = "dsi_lp_mode";
		qcom,mdss-dsi-off-command-state = "dsi_hs_mode";
		qcom,mdss-dsi-bl-pmic-control-type ="bl_ctrl_dcs";
		qcom,mdss-dsi-reset-sequence = <1 20>, <0 20>, <1 20>;
		//qcom,mdss-dsi-tx-eot-append;
	};
};
