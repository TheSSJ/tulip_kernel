/* Copyright (c) 2013-2014, The Linux Foundation. All rights reserved.
 *
 * This program is free software; you can redistribute it and/or modify
 * it under the terms of the GNU General Public License version 2 and
 * only version 2 as published by the Free Software Foundation.
 *
 * This program is distributed in the hope that it will be useful,
 * but WITHOUT ANY WARRANTY; without even the implied warranty of
 * MERCHANTABILITY or FITNESS FOR A PARTICULAR PURPOSE.  See the
 * GNU General Public License for more details.
 */

&mdss_mdp {
	dsi_samsung_1080p_cmd: qcom,mdss_dsi_samsung_1080p_cmd {
		qcom,mdss-dsi-panel-name = "zteSAM_S6E3FA3_SAM_10801920_5P2Inch";
		qcom,mdss-dsi-panel-type = "dsi_cmd_mode";
		qcom,mdss-dsi-panel-framerate = <60>;
		qcom,mdss-dsi-virtual-channel-id = <0>;
		qcom,mdss-dsi-stream = <0>;
		qcom,mdss-dsi-panel-width = <1080>;
		qcom,mdss-dsi-panel-height = <1920>;
		qcom,mdss-dsi-h-front-porch = <158>;
		qcom,mdss-dsi-h-back-porch = <45>;
		//qcom,mdss-dsi-h-front-porch = <216>;
		//qcom,mdss-dsi-h-back-porch = <52>;
		qcom,mdss-dsi-h-pulse-width = <8>;
		qcom,mdss-dsi-h-sync-skew = <0>;
		qcom,mdss-dsi-v-back-porch = <5>;
		qcom,mdss-dsi-v-front-porch = <7>;
		qcom,mdss-dsi-v-pulse-width = <2>;
	//	qcom,mdss-dsi-h-left-border = <0>;
	//	qcom,mdss-dsi-h-right-border = <0>;
	//	qcom,mdss-dsi-v-top-border = <0>;
	//	qcom,mdss-dsi-v-bottom-border = <0>;
		qcom,mdss-dsi-bpp = <24>;
		qcom,mdss-dsi-underflow-color = <0xff>;
		qcom,mdss-dsi-border-color = <0>;
		qcom,mdss-dsi-te-pin-select = <1>;
		qcom,mdss-dsi-te-dcs-command = <1>;
		qcom,mdss-dsi-te-check-enable;
		qcom,mdss-dsi-te-using-te-pin;
		qcom,mdss-dsi-h-sync-pulse = <0>;
		qcom,mdss-dsi-traffic-mode = "burst_mode";
		qcom,mdss-dsi-bllp-eof-power-mode;
		qcom,mdss-dsi-bllp-power-mode;
		qcom,mdss-dsi-lane-0-state;
		qcom,mdss-dsi-lane-1-state;
		qcom,mdss-dsi-lane-2-state;
		qcom,mdss-dsi-lane-3-state;
		//qcom,mdss-dsi-panel-timings = [F7 3a 28 00 6e 70 2c 3e 31 03 04 00];
		qcom,mdss-dsi-panel-timings = [E6 38 26 00 68 8E 2A 3C 2C 03 04 00];
		qcom,mdss-dsi-t-clk-post = <0x02>;
		qcom,mdss-dsi-t-clk-pre = <0x2b>;
		qcom,mdss-dsi-tx-eot-append;
		qcom,mdss-dsi-dma-trigger = "trigger_sw";
		qcom,mdss-dsi-mdp-trigger = "none";
		qcom,mdss-dsi-on-command = [05 01 00 00 20 00 01 11
				15 01 00 00 00 00 02 35 00
				39 01 00 00 00 00 03 f0 5a 5a
				39 01 00 00 00 00 03 fc 5a 5a
				39 01 00 00 00 00 03 f4 00 01
//				15 01 00 00 00 00 02 fd a8
				39 01 00 00 00 00 03 f0 a5 a5
				39 01 00 00 00 00 03 fc a5 a5
				15 01 00 00 00 00 02 57 40
				39 01 00 00 00 00 03 f0 5a 5a
				39 01 00 00 00 00 02 b0 08
				39 01 00 00 00 00 02 b1 0d
				39 01 00 00 00 00 03 f0 a5 a5

				15 01 00 00 00 00 02 53 20//28
				15 01 00 00 00 00 02 55 02
				15 01 00 00 56 00 02 51 00
				05 01 00 00 00 00 01 29

					];
		qcom,mdss-dsi-off-command = [
				05 01 00 00 2D 00 01 28
				05 01 00 00 96 00 01 10
		];
		qcom,mdss-dsi-acl-off-command = [
				15 01 00 00 0000 02 55 00
			];
		qcom,mdss-dsi-acl-on-command = [
				15 01 00 00 0000 02 55 02
			];

		qcom,mdss-dsi-hbm-off-command = [
				15 01 00 00 0000 02 53 20
			];
		qcom,mdss-dsi-hbm-on-command = [
				15 01 00 00 0000 02 53 e0
			];

		qcom,mdss-dsi-on-command-state = "dsi_lp_mode";
		qcom,mdss-dsi-off-command-state = "dsi_hs_mode";
		qcom,mdss-dsi-acl-command-state = "dsi_lp_mode";
		qcom,mdss-dsi-lp11-init;
		qcom,mdss-dsi-init-delay-us=<10000>;
		qcom,mdss-dsi-bl-min-level = <1>;
		qcom,mdss-dsi-bl-max-level = <255>;
		qcom,mdss-dsi-bl-pmic-control-type = "bl_ctrl_dcs";
		qcom,mdss-dsi-reset-sequence = <1 3>, <0 1>, <1 10>;
		//qcom,partial-update-enabled;
		qcom,mdss-pan-physical-width-dimension = <65>;
		qcom,mdss-pan-physical-height-dimension = <116>;
		qcom,esd-check-enabled;
	/*	qcom,mdss-dsi-panel-status-check-mode = "bta_check";*/

		qcom,mdss-dsi-panel-status-command = [06 01 00 01 05 00 02 0A 08];
		qcom,mdss-dsi-panel-status-command-state = "dsi_lp_mode";
		qcom,mdss-dsi-panel-status-check-mode = "reg_read";
		qcom,mdss-dsi-panel-status-value = <0x9c>;
	};
};
