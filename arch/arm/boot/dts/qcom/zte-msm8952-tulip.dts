/*
 * Copyright (c) 2015, The Linux Foundation. All rights reserved.
 *
 * This program is free software; you can redistribute it and/or modify
 * it under the terms of the GNU General Public License version 2 and
 * only version 2 as published by the Free Software Foundation.
 *
 * This program is distributed in the hope that it will be useful,
 * but WITHOUT ANY WARRANTY; without even the implied warranty of
 * MERCHANTABILITY or FITNESS FOR A PARTICULAR PURPOSE.  See the
 * GNU General Public License for more details.
 */

/dts-v1/;

#include "msm8952-mtp.dtsi"
#include "zte-msm8952-tulip.dtsi"
#include "dsi-panel-zte-samsung-1080p-cmd.dtsi"

/ {
	model = "Qualcomm Technologies, Inc. MSM8952 TULIP";
	compatible = "qcom,msm8952-mtp", "qcom,msm8952", "qcom,mtp";
	qcom,board-id= <110 0>;
};

&mdss_dsi0 {
	qcom,dsi-pref-prim-pan = <&dsi_samsung_1080p_cmd>;
	qcom,platform-reset-gpio = <&msm_gpio 8 0>;
	qcom,platform-vddi-gpio = <&msm_gpio 96 0>;
	qcom,platform-vci-gpio = <&msm_gpio 89 0>;
	qcom,platform-te-gpio = <&msm_gpio 24 0>;
};
