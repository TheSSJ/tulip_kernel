/* Copyright (c) 2015, The Linux Foundation. All rights reserved.
 *
 * This program is free software; you can redistribute it and/or modify
 * it under the terms of the GNU General Public License version 2 and
 * only version 2 as published by the Free Software Foundation.
 *
 * This program is distributed in the hope that it will be useful,
 * but WITHOUT ANY WARRANTY; without even the implied warranty of
 * MERCHANTABILITY or FITNESS FOR A PARTICULAR PURPOSE.  See the
 * GNU General Public License for more details.
 */

&mdss_mdp {
	dsi_xingyuan_rm68200_auo_8p0_800P_video_vid: qcom,mdss_dsi_xingyuan_rm68200_auo_8p0_800p_video {
		qcom,mdss-dsi-panel-name = "zteXINGYUAN(RM68200)AUO_800*1280_8P0Inch";
		qcom,mdss-dsi-panel-type = "dsi_video_mode";
		qcom,cont-splash-enabled;
		qcom,mdss-pan-physical-width-dimension = <108>;
		qcom,mdss-pan-physical-height-dimension = <173>;
		qcom,mdss-dsi-panel-framerate = <60>;
		qcom,mdss-dsi-virtual-channel-id = <0>;
		qcom,mdss-dsi-stream = <0>;
		qcom,mdss-dsi-panel-width = <800>;
		qcom,mdss-dsi-panel-height = <1280>;
		qcom,mdss-dsi-h-front-porch = <24>;
		qcom,mdss-dsi-h-back-porch = <138>;
		qcom,mdss-dsi-h-pulse-width = <4>;
		qcom,mdss-dsi-h-sync-skew = <0>;
		qcom,mdss-dsi-v-back-porch = <8>;
		qcom,mdss-dsi-v-front-porch = <8>;
		qcom,mdss-dsi-v-pulse-width = <4>;
		qcom,mdss-dsi-h-left-border = <0>;
		qcom,mdss-dsi-h-right-border = <0>;
		qcom,mdss-dsi-v-top-border = <0>;
		qcom,mdss-dsi-v-bottom-border = <0>;
		qcom,mdss-dsi-bpp = <24>;
		qcom,mdss-dsi-underflow-color = <0xff>;
		qcom,mdss-dsi-border-color = <0>;
		qcom,mdss-dsi-h-sync-pulse = <0>;
		qcom,mdss-dsi-traffic-mode = "burst_mode";

		qcom,mdss-dsi-te-pin-select = <1>;
		qcom,mdss-dsi-te-dcs-command = <1>;
		qcom,mdss-dsi-te-check-enable;
		qcom,mdss-dsi-te-using-te-pin;
		qcom,mdss-dsi-wr-mem-start = <0x2c>;
		qcom,mdss-dsi-wr-mem-continue = <0x3c>;

		qcom,mdss-dsi-bllp-eof-power-mode;
		qcom,mdss-dsi-bllp-power-mode;
		qcom,mdss-dsi-lane-0-state;
		qcom,mdss-dsi-lane-1-state;
		qcom,mdss-dsi-lane-2-state;
		qcom,mdss-dsi-lane-3-state;
		qcom,mdss-dsi-panel-timings = [87 1C 12 00 42 42 18 20 17 03 04 00];
		qcom,mdss-dsi-t-clk-post = <0x04>;
		qcom,mdss-dsi-t-clk-pre = <0x1B>;
		qcom,mdss-dsi-bl-min-level = <1>;
		qcom,mdss-dsi-bl-max-level = <255>;
		qcom,mdss-dsi-dma-trigger = "trigger_sw";
		qcom,mdss-dsi-mdp-trigger = "none";
		qcom,mdss-dsi-on-command = [

39 01 00 00 00 00 02 FE 01
39 01 00 00 00 00 02 0E 01
39 01 00 00 00 00 02 24 C0
39 01 00 00 00 00 02 25 53
39 01 00 00 00 00 02 26 00
39 01 00 00 00 00 02 27 10
39 01 00 00 00 00 02 29 10
39 01 00 00 00 00 02 16 B0
39 01 00 00 00 00 02 2F 54
39 01 00 00 00 00 02 34 6B
39 01 00 00 00 00 02 36 80
39 01 00 00 00 00 02 1B 50
39 01 00 00 00 00 02 12 09
39 01 00 00 00 00 02 1A 09
39 01 00 00 00 00 02 46 80
39 01 00 00 00 00 02 52 58
39 01 00 00 00 00 02 53 00
39 01 00 00 00 00 02 54 58
39 01 00 00 00 00 02 55 00
39 01 00 00 00 00 02 12 09
39 01 00 00 00 00 02 FE 03
39 01 00 00 00 00 02 00 03
39 01 00 00 00 00 02 01 16
39 01 00 00 00 00 02 02 06
39 01 00 00 00 00 02 03 0F
39 01 00 00 00 00 02 04 90
39 01 00 00 00 00 02 05 00
39 01 00 00 00 00 02 06 50
39 01 00 00 00 00 02 07 02
39 01 00 00 00 00 02 08 16
39 01 00 00 00 00 02 09 0D
39 01 00 00 00 00 02 0A 11
39 01 00 00 00 00 02 0B 7D
39 01 00 00 00 00 02 0C 00
39 01 00 00 00 00 02 0D 50
39 01 00 00 00 00 02 0E 07
39 01 00 00 00 00 02 0F 08
39 01 00 00 00 00 02 10 09
39 01 00 00 00 00 02 11 0A
39 01 00 00 00 00 02 12 00
39 01 00 00 00 00 02 13 85
39 01 00 00 00 00 02 14 00
39 01 00 00 00 00 02 15 C3
39 01 00 00 00 00 02 16 04
39 01 00 00 00 00 02 17 03
39 01 00 00 00 00 02 18 04
39 01 00 00 00 00 02 19 05
39 01 00 00 00 00 02 1A 06
39 01 00 00 00 00 02 1B 00
39 01 00 00 00 00 02 1C 7D
39 01 00 00 00 00 02 1D 00
39 01 00 00 00 00 02 1E 82
39 01 00 00 00 00 02 1F 08
39 01 00 00 00 00 02 20 00
39 01 00 00 00 00 02 21 00
39 01 00 00 00 00 02 22 00
39 01 00 00 00 00 02 23 0A
39 01 00 00 00 00 02 24 0B
39 01 00 00 00 00 02 25 2D
39 01 00 00 00 00 02 26 08
39 01 00 00 00 00 02 27 00
39 01 00 00 00 00 02 28 00
39 01 00 00 00 00 02 29 80
39 01 00 00 00 00 02 2A 07
39 01 00 00 00 00 02 2B 08
39 01 00 00 00 00 02 2D 01
39 01 00 00 00 00 02 2F 02
39 01 00 00 00 00 02 30 00
39 01 00 00 00 00 02 31 40
39 01 00 00 00 00 02 32 05
39 01 00 00 00 00 02 33 08
39 01 00 00 00 00 02 34 54
39 01 00 00 00 00 02 35 7D
39 01 00 00 00 00 02 36 00
39 01 00 00 00 00 02 37 03
39 01 00 00 00 00 02 38 04
39 01 00 00 00 00 02 39 05
39 01 00 00 00 00 02 3A 06
39 01 00 00 00 00 02 3B 00
39 01 00 00 00 00 02 3D 40
39 01 00 00 00 00 02 3F 05
39 01 00 00 00 00 02 40 08
39 01 00 00 00 00 02 41 54
39 01 00 00 00 00 02 42 7D
39 01 00 00 00 00 02 43 00
39 01 00 00 00 00 02 44 00
39 01 00 00 00 00 02 45 00
39 01 00 00 00 00 02 46 00
39 01 00 00 00 00 02 47 00
39 01 00 00 00 00 02 48 00
39 01 00 00 00 00 02 49 00
39 01 00 00 00 00 02 4A 00
39 01 00 00 00 00 02 4B 00
39 01 00 00 00 00 02 4C 00
39 01 00 00 00 00 02 4D 00
39 01 00 00 00 00 02 4E 00
39 01 00 00 00 00 02 4F 00
39 01 00 00 00 00 02 50 00
39 01 00 00 00 00 02 51 00
39 01 00 00 00 00 02 52 00
39 01 00 00 00 00 02 53 00
39 01 00 00 00 00 02 54 00
39 01 00 00 00 00 02 55 00
39 01 00 00 00 00 02 56 00
39 01 00 00 00 00 02 58 00
39 01 00 00 00 00 02 59 00
39 01 00 00 00 00 02 5A 00
39 01 00 00 00 00 02 5B 00
39 01 00 00 00 00 02 5C 00
39 01 00 00 00 00 02 5D 00
39 01 00 00 00 00 02 5E 00
39 01 00 00 00 00 02 5F 00
39 01 00 00 00 00 02 60 00
39 01 00 00 00 00 02 61 00
39 01 00 00 00 00 02 62 00
39 01 00 00 00 00 02 63 00
39 01 00 00 00 00 02 64 00
39 01 00 00 00 00 02 65 00
39 01 00 00 00 00 02 66 00
39 01 00 00 00 00 02 67 00
39 01 00 00 00 00 02 68 00
39 01 00 00 00 00 02 69 00
39 01 00 00 00 00 02 6A 00
39 01 00 00 00 00 02 6B 00
39 01 00 00 00 00 02 6C 00
39 01 00 00 00 00 02 6D B8
39 01 00 00 00 00 02 6E 00
39 01 00 00 00 00 02 6F 00
39 01 00 00 00 00 02 70 00
39 01 00 00 00 00 02 71 22
39 01 00 00 00 00 02 72 80
39 01 00 00 00 00 02 73 00
39 01 00 00 00 00 02 74 1E
39 01 00 00 00 00 02 75 08
39 01 00 00 00 00 02 76 1E
39 01 00 00 00 00 02 77 08
39 01 00 00 00 00 02 78 1E
39 01 00 00 00 00 02 79 08
39 01 00 00 00 00 02 7A 00
39 01 00 00 00 00 02 7B 00
39 01 00 00 00 00 02 7C 00
39 01 00 00 00 00 02 7D 00
39 01 00 00 00 00 02 7E 0B
39 01 00 00 00 00 02 7F 0B
39 01 00 00 00 00 02 80 0A
39 01 00 00 00 00 02 81 0A
39 01 00 00 00 00 02 82 09
39 01 00 00 00 00 02 83 09
39 01 00 00 00 00 02 84 08
39 01 00 00 00 00 02 85 08
39 01 00 00 00 00 02 86 3F
39 01 00 00 00 00 02 87 3F
39 01 00 00 00 00 02 88 3F
39 01 00 00 00 00 02 89 3F
39 01 00 00 00 00 02 8A 3F
39 01 00 00 00 00 02 8B 3F
39 01 00 00 00 00 02 8C 3F
39 01 00 00 00 00 02 8D 19
39 01 00 00 00 00 02 8E 19
39 01 00 00 00 00 02 8F 18
39 01 00 00 00 00 02 90 18
39 01 00 00 00 00 02 91 00
39 01 00 00 00 00 02 92 1C
39 01 00 00 00 00 02 93 1C
39 01 00 00 00 00 02 94 1C
39 01 00 00 00 00 02 95 1C
39 01 00 00 00 00 02 96 00
39 01 00 00 00 00 02 97 18
39 01 00 00 00 00 02 98 18
39 01 00 00 00 00 02 99 19
39 01 00 00 00 00 02 9A 19
39 01 00 00 00 00 02 9B 3F
39 01 00 00 00 00 02 9C 3F
39 01 00 00 00 00 02 9D 3F
39 01 00 00 00 00 02 9E 3F
39 01 00 00 00 00 02 9F 3F
39 01 00 00 00 00 02 A0 3F
39 01 00 00 00 00 02 A2 3F
39 01 00 00 00 00 02 A3 08
39 01 00 00 00 00 02 A4 08
39 01 00 00 00 00 02 A5 09
39 01 00 00 00 00 02 A6 09
39 01 00 00 00 00 02 A7 0A
39 01 00 00 00 00 02 A9 0A
39 01 00 00 00 00 02 AA 0B
39 01 00 00 00 00 02 AB 0B
39 01 00 00 00 00 02 AC 3F
39 01 00 00 00 00 02 AD 3F
39 01 00 00 00 00 02 AE 3F
39 01 00 00 00 00 02 AF 3F
39 01 00 00 00 00 02 B0 3F
39 01 00 00 00 00 02 B1 3F
39 01 00 00 00 00 02 B2 3F
39 01 00 00 00 00 02 B3 05
39 01 00 00 00 00 02 B4 01
39 01 00 00 00 00 02 B5 3F
39 01 00 00 00 00 02 B6 17
39 01 00 00 00 00 02 B7 13
39 01 00 00 00 00 02 B8 15
39 01 00 00 00 00 02 B9 11
39 01 00 00 00 00 02 BA 0F
39 01 00 00 00 00 02 BB 0B
39 01 00 00 00 00 02 BC 0D
39 01 00 00 00 00 02 BD 09
39 01 00 00 00 00 02 BE 07
39 01 00 00 00 00 02 BF 03
39 01 00 00 00 00 02 C0 3F
39 01 00 00 00 00 02 C1 3F
39 01 00 00 00 00 02 C2 3F
39 01 00 00 00 00 02 C3 3F
39 01 00 00 00 00 02 C4 02
39 01 00 00 00 00 02 C5 06
39 01 00 00 00 00 02 C6 08
39 01 00 00 00 00 02 C7 0C
39 01 00 00 00 00 02 C8 0A
39 01 00 00 00 00 02 C9 0E
39 01 00 00 00 00 02 CA 10
39 01 00 00 00 00 02 CB 14
39 01 00 00 00 00 02 CC 12
39 01 00 00 00 00 02 CD 16
39 01 00 00 00 00 02 CE 3F
39 01 00 00 00 00 02 CF 00
39 01 00 00 00 00 02 D0 04
39 01 00 00 00 00 02 D1 3F
39 01 00 00 00 00 02 D2 3F
39 01 00 00 00 00 02 D3 3F
39 01 00 00 00 00 02 D4 3F
39 01 00 00 00 00 02 D5 3F
39 01 00 00 00 00 02 D6 3F
39 01 00 00 00 00 02 D7 3F
39 01 00 00 00 00 02 DC 02
39 01 00 00 00 00 02 DD 00
39 01 00 00 00 00 02 DE 08
39 01 00 00 00 00 02 DF 40
39 01 00 00 00 00 02 FE 0E
39 01 00 00 00 00 02 01 75
39 01 00 00 00 00 02 FE 04
39 01 00 00 00 00 02 60 05
39 01 00 00 00 00 02 61 0A
39 01 00 00 00 00 02 62 0E
39 01 00 00 00 00 02 63 0D
39 01 00 00 00 00 02 64 04
39 01 00 00 00 00 02 65 0F
39 01 00 00 00 00 02 66 0D
39 01 00 00 00 00 02 67 09
39 01 00 00 00 00 02 68 16
39 01 00 00 00 00 02 69 0A
39 01 00 00 00 00 02 6A 0C
39 01 00 00 00 00 02 6B 08
39 01 00 00 00 00 02 6C 10
39 01 00 00 00 00 02 6D 14
39 01 00 00 00 00 02 6E 0E
39 01 00 00 00 00 02 6F 00
39 01 00 00 00 00 02 70 05
39 01 00 00 00 00 02 71 0A
39 01 00 00 00 00 02 72 0E
39 01 00 00 00 00 02 73 0D
39 01 00 00 00 00 02 74 04
39 01 00 00 00 00 02 75 0F
39 01 00 00 00 00 02 76 0D
39 01 00 00 00 00 02 77 09
39 01 00 00 00 00 02 78 16
39 01 00 00 00 00 02 79 0A
39 01 00 00 00 00 02 7A 0C
39 01 00 00 00 00 02 7B 08
39 01 00 00 00 00 02 7C 10
39 01 00 00 00 00 02 7D 14
39 01 00 00 00 00 02 7E 0E
39 01 00 00 00 00 02 7F 00
39 01 00 00 00 00 02 FE 0B
39 01 00 00 00 00 02 1B 00
39 01 00 00 00 00 02 FE 00
39 01 00 00 00 00 02 58 AD
39 01 00 00 00 00 02 35 01
			   39 01 00 00 00 00 02 53 2c

                         05 01 00 00 c8 00 02 11 00
                         05 01 00 00 0a 00 02 29 00
			];
		qcom,mdss-dsi-off-command = [05 01 00 00 96 00 02 28 00
				 05 01 00 00 96 00 02 10 00];
		qcom,mdss-dsi-on-command-state = "dsi_lp_mode";
		qcom,mdss-dsi-off-command-state = "dsi_hs_mode";
		qcom,mdss-dsi-bl-pmic-control-type ="bl_ctrl_dcs";
		qcom,mdss-dsi-reset-sequence = <1 20>, <0 20>, <1 20>;
		//qcom,mdss-dsi-tx-eot-append;
	};
};
